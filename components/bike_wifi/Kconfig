## components/bike_wifi/Kconfig
```kconfig
menu "Bike Wi-Fi data link"
    config BIKE_LINK_AP_SSID
        string "ESP32 hotspot name"
        default "BalanceBike-ESP32"
    config BIKE_LINK_AP_PASSWORD
        string "ESP32 hotspot password (8-63 characters)"
        default "balance123"
    config BIKE_LINK_AP_CHANNEL
        int "Hotspot channel"
        range 1 11
        default 6
endmenu
```

## main/Kconfig.imu
```kconfig
menu "JY901P IMU"
    config BIKE_IMU_JY901P
        bool "Use real JY901P IMU over I2C"
        default y
        help
            Read JY901P roll and body-X angular rate over I2C, independently
            of the ODrive mock option. Mount sensor X forward, Y left, Z up.
            Startup fails if the sensor is missing or configuration fails.

    if BIKE_IMU_JY901P
        config BIKE_IMU_SDA_GPIO
            int "JY901P SDA GPIO"
            range 0 33
            default 21

        config BIKE_IMU_SCL_GPIO
            int "JY901P SCL GPIO"
            range 0 33
            default 22

        config BIKE_IMU_I2C_ADDRESS
            hex "JY901P 7-bit I2C address (not shifted)"
            range 0x08 0x77
            default 0x50

        config BIKE_IMU_I2C_HZ
            int "JY901P I2C clock (Hz)"
            range 100000 400000
            default 100000

        config BIKE_IMU_BANDWIDTH
            int "JY901P bandwidth code (0=256, 1=184, 2=94, 3=44, 4=21, 5=10, 6=5 Hz)"
            range 0 6
            default 2
            help
                Vendor SDK bandwidth enumeration. Nominal bandwidth names
                can vary with sensor firmware. Default is code 2 (94 Hz).
    endif
endmenu
```

## main/Kconfig.projbuild
```kconfig
menu "Balance bike framework"
    config BIKE_WIFI_DIAGNOSTIC
        bool "Run isolated Wi-Fi diagnostic instead of bike application"
        default n
        help
            Print a ten-second heartbeat without Wi-Fi, then start a minimal
            SoftAP based on the ESP-IDF example. No bike tasks, UDP sockets,
            sensor ports or motor ports run in this mode. Disable this option
            and rebuild to return to the selected bike application.

    config BIKE_PC_LINK_TEST
        bool "Run legacy PC link test instead of ODrive control"
        depends on !BIKE_WIFI_DIAGNOSTIC
        default n
        help
            Build the legacy UDP 3333 application with motor output disabled.
            Leave this disabled to use the real ODrive UART control application
            and its UDP 3334 interface for the 3D viewer.

    config BIKE_MOCK_HARDWARE
        bool "Use synthetic ODrive feedback / fallback IMU (no motor output)"
        default y
        help
            Applies to the legacy PC link test. Keep ODrive feedback synthetic.
            The IMU is also synthetic unless
            BIKE_IMU_JY901P is enabled. Disabling this still requires a real
            ODrive port implementation. There is no automatic motor arming.

    rsource "Kconfig.imu"

    config BIKE_MOCK_MOTION
        bool "Generate a +/-2 degree, 4 second mock roll waveform"
        depends on BIKE_MOCK_HARDWARE && !BIKE_IMU_JY901P
        default y
        help
            Synthetic roll and its analytic gyro derivative exercise changing
            policy inputs. Flywheel feedback stays at zero. This is an input
            waveform, not a vehicle dynamics simulation or a closed-loop test.
            Disable to restore the fixed 0.2 degree communication test.

    config BIKE_WIFI_AP_SSID
        string "Legacy PC link hotspot SSID"
        default "BalanceBike-ESP32"

    config BIKE_WIFI_AP_PASSWORD
        string "Legacy PC link hotspot password (8-63 characters)"
        default "balance123"

    config BIKE_WIFI_AP_CHANNEL
        int "Legacy PC link hotspot channel"
        range 1 11
        default 6
endmenu
```

## sdkconfig.defaults
```kconfig
CONFIG_IDF_TARGET="esp32"
CONFIG_FREERTOS_HZ=1000
CONFIG_ESP_DEFAULT_CPU_FREQ_MHZ_240=y
CONFIG_BIKE_MOCK_HARDWARE=y
CONFIG_BIKE_IMU_JY901P=y
CONFIG_BIKE_IMU_SDA_GPIO=21
CONFIG_BIKE_IMU_SCL_GPIO=22
CONFIG_BIKE_IMU_I2C_ADDRESS=0x50
CONFIG_BIKE_IMU_I2C_HZ=100000
CONFIG_BIKE_IMU_BANDWIDTH=2
CONFIG_ESP_PHY_MAX_WIFI_TX_POWER=10
```

## standalone/odrive_uart/sdkconfig.defaults
```kconfig
CONFIG_IDF_TARGET="esp32"
CONFIG_ESP_CONSOLE_UART_DEFAULT=y
CONFIG_ESP_CONSOLE_UART_BAUDRATE=115200
CONFIG_FREERTOS_HZ=1000
CONFIG_ESP_DEFAULT_CPU_FREQ_MHZ_240=y
CONFIG_BIKE_IMU_JY901P=y
CONFIG_BIKE_IMU_SDA_GPIO=21
CONFIG_BIKE_IMU_SCL_GPIO=22
CONFIG_BIKE_IMU_I2C_ADDRESS=0x50
CONFIG_BIKE_IMU_I2C_HZ=100000
CONFIG_BIKE_IMU_BANDWIDTH=2
```
